## conf/layer.conf
```bitbake
# We have a conf and classes directory, add to BBPATH
BBPATH .= ":${LAYERDIR}"

# We have a recipes-* directories, add to BBFILES
BBFILES += "${LAYERDIR}/recipes-*/*/*.bb \
	${LAYERDIR}/recipes-*/*/*.bbappend"

BBFILE_COLLECTIONS += "pllinux-x86"
BBFILE_PATTERN_pllinux-x86 = "^${LAYERDIR}/"
BBFILE_PRIORITY_pllinux-x86 = "6"
```

## conf/machine/pllinux-x86.conf
```bitbake
#@TYPE: Machine
#@NAME: pllinux-x86

#@DESCRIPTION: Machine configuration for pllinux-x86 systems

PREFERRED_PROVIDER_virtual/kernel ?= "linux-yocto-custom"


DEFAULTTUNE ?= "corei7-64"
require conf/machine/include/tune-corei7.inc

require conf/machine/include/x86-base.inc

MACHINE_FEATURES += "wifi efi pcbios"


XSERVER ?= "${XSERVER_X86_BASE} \
           ${XSERVER_X86_EXT} \
           ${XSERVER_X86_VESA} \
           "

MACHINE_EXTRA_RRECOMMENDS += "linux-firmware v86d eee-acpi-scripts"

EXTRA_OECONF_append_pn-matchbox-panel-2 = " --with-battery=acpi"

GLIBC_ADDONS = "nptl"

APPEND += "video=vesafb vga=0x318"
```
